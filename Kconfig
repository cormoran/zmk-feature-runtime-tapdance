## Kconfig
```kconfig
config ZMK_RUNTIME_TAPDANCE
    bool "Enable runtime tap dance"
    select SETTINGS
    select ZMK_CUSTOM_SETTINGS
    select ZMK_CUSTOM_SETTINGS_ARRAY
    select ZMK_CUSTOM_SETTINGS_KEYSPACE
    select ZMK_BEHAVIOR_LOCAL_IDS
    select ZMK_BEHAVIOR_METADATA

if ZMK_RUNTIME_TAPDANCE

config ZMK_RUNTIME_TAPDANCE_MAX_TAPDANCES
    int "Maximum runtime tap dances"
    default 16
    range 1 16

config ZMK_RUNTIME_TAPDANCE_NAME_MAX_LEN
    int "Maximum tap dance name length in UTF-8 bytes"
    default 24
    range 1 24

config ZMK_RUNTIME_TAPDANCE_POOL_BYTES
    int "Shared runtime tap dance name and binding pool size"
    default 1024
    range 128 4096

config ZMK_RUNTIME_TAPDANCE_MAX_ACTIVE
    int "Maximum simultaneous runtime tap dances"
    default 16
    range 1 64

config ZMK_RUNTIME_TAPDANCE_NATIVE_BLE_TEST
    bool "Enable native BLE fixture linker workaround"
    depends on ARCH_POSIX
    help
      Test-only workaround for the selected ZMK baseline's const local-ID map
      on native hosts. Never enable in consumer firmware.

config ZMK_RUNTIME_TAPDANCE_TEST
    bool "Enable runtime tap dance public event tests"

config ZMK_RUNTIME_TAPDANCE_STUDIO_RPC
    bool "Enable runtime tap dance custom Studio RPC"
    depends on ZMK_STUDIO
    select ZMK_CUSTOM_SETTINGS_STUDIO_RPC

endif

choice ZMK_BEHAVIOR_LOCAL_ID_TYPE
    default ZMK_BEHAVIOR_LOCAL_ID_TYPE_CRC16 if ZMK_RUNTIME_TAPDANCE && !ZMK_STUDIO
endchoice
```

## dts/bindings/behaviors/cormoran,zmk-behavior-runtime-tapdance.yaml
```yaml
# SPDX-License-Identifier: MIT
description: Configurable runtime tap dance
compatible: "cormoran,zmk-behavior-runtime-tapdance"
include: one_param.yaml
```

## dts/bindings/behaviors/zmk,behavior-tapdance-test-reject.yaml
```yaml
description: Test-only behavior that rejects invocation
compatible: "zmk,behavior-tapdance-test-reject"
include: zero_param.yaml
```
